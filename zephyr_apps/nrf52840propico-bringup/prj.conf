## CMakeLists.txt
```
cmake_minimum_required(VERSION 3.20)
find_package(Zephyr REQUIRED HINTS $ENV{ZEPHYR_BASE})
project(helix_nrf52840propico_bringup)

target_sources(app PRIVATE
  src/main.cpp
)
```

## prj.conf
```kconfig
CONFIG_CPP=y
CONFIG_STD_CPP17=y

CONFIG_GPIO=y

CONFIG_SERIAL=y
CONFIG_CONSOLE=y
CONFIG_UART_CONSOLE=y
CONFIG_PRINTK=y

CONFIG_LOG=y
CONFIG_LOG_MODE_IMMEDIATE=y
CONFIG_LOG_BACKEND_UART=y
CONFIG_LOG_PRINTK=y

CONFIG_MAIN_STACK_SIZE=2048
```

## src/main.cpp
```c
#include <zephyr/device.h>
#include <zephyr/drivers/gpio.h>
#include <zephyr/kernel.h>
#include <zephyr/sys/printk.h>

namespace {

const gpio_dt_spec g_led = GPIO_DT_SPEC_GET_OR(DT_ALIAS(led0), gpios, {0});

}

int main() {
    if (!gpio_is_ready_dt(&g_led)) {
        printk("propico bringup: led0 not ready\n");
        return 1;
    }

    if (gpio_pin_configure_dt(&g_led, GPIO_OUTPUT_INACTIVE) != 0) {
        printk("propico bringup: led0 config failed\n");
        return 2;
    }

    printk("propico bringup: booted, led0 heartbeat active\n");

    bool on = false;
    uint32_t tick = 0;
    while (true) {
        on = !on;
        gpio_pin_set_dt(&g_led, on ? 1 : 0);
        printk("propico bringup: tick %u led=%u\n", tick++, on ? 1u : 0u);
        k_msleep(500);
    }
}
```
