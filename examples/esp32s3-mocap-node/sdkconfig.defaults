## examples/esp32s3-mocap-node/sdkconfig.defaults
```kconfig
CONFIG_ESP_MAIN_TASK_STACK_SIZE=8192

# ── Partition table ─────────────────────────────────────────────────────────
CONFIG_PARTITION_TABLE_CUSTOM=y
CONFIG_PARTITION_TABLE_CUSTOM_FILENAME="partitions_ota.csv"

# ── OTA ─────────────────────────────────────────────────────────────────────
# Rollback: if app never calls esp_ota_mark_app_valid_cancel_rollback(), the
# bootloader will revert to the previous image on the next reset.
CONFIG_BOOTLOADER_APP_ROLLBACK_ENABLE=y

# ── Bluetooth (NimBLE) ───────────────────────────────────────────────────────
CONFIG_BT_ENABLED=y
CONFIG_BT_NIMBLE_ENABLED=y
# Disable Bluedroid to save ~100 KB flash.
CONFIG_BT_BLUEDROID_ENABLED=n
# NimBLE host task stack size (bytes).
CONFIG_BT_NIMBLE_HOST_TASK_STACK_SIZE=4096
# Maximum number of simultaneous GATT connections.
CONFIG_BT_NIMBLE_MAX_CONNECTIONS=1
```

## examples/wroom32-mocap-node/sdkconfig.defaults
```kconfig
CONFIG_ESP_MAIN_TASK_STACK_SIZE=8192

# ── Flash size ───────────────────────────────────────────────────────────────
# ESP32-WROOM-32 module used here has 4 MB flash.
CONFIG_ESPTOOLPY_FLASHSIZE_4MB=y

# ── Partition table ──────────────────────────────────────────────────────────
CONFIG_PARTITION_TABLE_CUSTOM=y
CONFIG_PARTITION_TABLE_CUSTOM_FILENAME="partitions_ota.csv"

# ── OTA rollback ─────────────────────────────────────────────────────────────
# If app never calls esp_ota_mark_app_valid_cancel_rollback(), the bootloader
# reverts to the previous image on the next reset.
CONFIG_BOOTLOADER_APP_ROLLBACK_ENABLE=y

# ── Bluetooth (NimBLE) ───────────────────────────────────────────────────────
CONFIG_BT_ENABLED=y
CONFIG_BT_NIMBLE_ENABLED=y
CONFIG_BT_BLUEDROID_ENABLED=n
CONFIG_BT_NIMBLE_HOST_TASK_STACK_SIZE=4096
CONFIG_BT_NIMBLE_MAX_CONNECTIONS=1

# ── I2C ──────────────────────────────────────────────────────────────────────
# Suppress deprecation warning — we use the new esp_driver_i2c, not driver/i2c.h
CONFIG_I2C_SUPPRESS_DEPRECATE_WARN=y
```

## zephyr_apps/nrf52dk-ota-ble/sysbuild/mcuboot/boards/nrf52840dongle_nrf52840.conf
```kconfig
CONFIG_LOG=n

CONFIG_CONSOLE=n
CONFIG_SERIAL=n
CONFIG_UART_NRFX=n
CONFIG_UART_INTERRUPT_DRIVEN=n
CONFIG_UART_LINE_CTRL=n

CONFIG_GPIO=n
CONFIG_MCUBOOT_SERIAL=n
CONFIG_BOOT_SERIAL_CDC_ACM=n
CONFIG_BOOT_SERIAL_UART=n

CONFIG_MULTITHREADING=n

CONFIG_USB_DEVICE_STACK=n
CONFIG_USB_DEVICE_REMOTE_WAKEUP=n
CONFIG_USB_CDC_ACM=n
```

## zephyr_apps/nrf52dk-ota-ble/sysbuild/mcuboot/boards/promicro_nrf52840_nrf52840.conf
```kconfig
CONFIG_LOG=n
CONFIG_PRINTK=n

CONFIG_BOARD_SERIAL_BACKEND_CDC_ACM=n
CONFIG_CONSOLE=n
CONFIG_SERIAL=n
CONFIG_UART_NRFX=n
CONFIG_UART_INTERRUPT_DRIVEN=n
CONFIG_UART_LINE_CTRL=n

CONFIG_GPIO=n
CONFIG_MCUBOOT_SERIAL=n
CONFIG_BOOT_SERIAL_CDC_ACM=n
CONFIG_BOOT_SERIAL_UART=n
CONFIG_BOOT_ECDSA_TINYCRYPT=y
CONFIG_BOOT_ECDSA_CC310=n
CONFIG_BOOT_SIGNATURE_USING_KMU=n

# ProPico requires multithreading in MCUboot: the RC clock driver uses
# k_sem internally, causing a fault with CONFIG_MULTITHREADING=n.
CONFIG_MULTITHREADING=y
CONFIG_LTO=n
# Peripheral cleanup disabled: the nrf_cleanup_peripheral() path causes
# HardFault on ProPico clones that lack the expected UARTE/GPIO layout.
CONFIG_MCUBOOT_NRF_CLEANUP_PERIPHERAL=n
CONFIG_CLOCK_CONTROL_NRF_K32SRC_RC=y
CONFIG_CLOCK_CONTROL_NRF_K32SRC_XTAL=n

CONFIG_USB_DEVICE_STACK=n
CONFIG_USB_DEVICE_STACK_NEXT=n
CONFIG_USB_DEVICE_REMOTE_WAKEUP=n
CONFIG_USB_CDC_ACM=n
CONFIG_USBD_CDC_ACM_CLASS=n
```
